#include "includes.h"
/***************************************

函数名：SPI_Init
函数参数：
函数返回值：无
函数功能：SPI实现W25Q64的初始化
函数描述：
 PB3 SCK PB4  MISO  PB5 M0SI PB14 cs 
****************************************/
void SPI_Init()
{
	//配置MCU相应的引脚时钟线
  RCC->AHB1ENR |=(0x1<<1);
 
  //配置引脚的模式寄存器 设置为通用输出模式
  GPIOB->MODER &=~(0x3f<<6);
  GPIOB->MODER |=(0x2a<<6);

  GPIOB->MODER &=~(0x3<<28);
	GPIOB->MODER |=(0x1<<28);	
	
	//复用功能配置
	GPIOB->AFR[0] &=~(0xfff<<12);
	GPIOB->AFR[0] |=(0x555<<12);
	
	//配置SPI的时钟
	 RCC->APB2ENR |=(0x1<<12);
	 
	//配置SPI工作在主模式
	SPI1->CR1 |=(0x1<<2);
  
  //配置SPI的全双工
	SPI1->CR1 &=~(0x1<<15);
  SPI1->CR1 &=~(0x1<<10);

  //配置SPI的软件从设备管理
	SPI1->CR1 |=(0x3<<8);
	
	/********************
	 结合具体的芯片
	******************/
	 //配置波特率
	 SPI1->CR1 &=~(0x7<<3);
	 SPI1->CR1 |=(0x1<<3);
	 
	 //数据位数
	 SPI1->CR1 &=~(0x1<<11);
		
		//MSB在前
	 SPI1->CR1 &=~(0x1<<7);
		//时钟极性 相位
	 SPI1->CR1 |=(0x3<<0);

	//SPI使能
	 SPI1->CR1 |=(0x1<<6);

}


/***************************************

函数名：SPI_SendDate(u8 date)
函数参数：
函数返回值：无
函数功能：MCU SPI发送数据
函数描述：
 
****************************************/

void SPI_SendDate(u8 date)
{
	 //等待上次数据发送完毕
	while((SPI1->SR &1<<1)==0);
	//发送该次数据
	SPI1->DR = date;
	//等待接收到数据
	while((SPI1->SR &1<<0)==0);
	//读出接受到的数据
	date=SPI1->DR;
  
}

/***************************************

函数名：SPI_ReceiveDate()
函数参数：
函数返回值：
函数功能：MCU SPI发送数据
函数描述：
 
****************************************/
u8 SPI_ReceiveDate()
{
	u8 date;
	 //等待上次数据发送完毕
	while((SPI1->SR &1<<1)==0);
	//发送该次数据
	SPI1->DR = 0x22;
	//等待接收到数据
	while((SPI1->SR &1<<0)==0);
	//读出接受到的数据
	date=SPI1->DR;
	
	return date;
  
}
